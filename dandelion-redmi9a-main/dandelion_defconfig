## dandelion-redmi9a-main/dandelion_defconfig
```kconfig
CONFIG_LOCALVERSION="-nethunter"
CONFIG_PACKET=y
CONFIG_UNIX=y
CONFIG_INET=y
CONFIG_IP_ADVANCED_ROUTER=y
CONFIG_IP_MULTIPLE_TABLES=y
CONFIG_IP_ROUTE_MULTIPATH=y
CONFIG_NETFILTER=y
CONFIG_NETFILTER_ADVANCED=y

# HID & RNDIS support
CONFIG_USB_GADGET=y
CONFIG_USB_CONFIGFS=y
CONFIG_USB_CONFIGFS_HID=y
CONFIG_USB_CONFIGFS_RNDIS=y
CONFIG_USB_CONFIGFS_MASS_STORAGE=y
CONFIG_USB_HID=y
CONFIG_HID_GENERIC=y

# USB Ethernet gadget drivers
CONFIG_USB_NET_RNDIS_HOST=m
CONFIG_USB_NET_CDCETHER=m
CONFIG_USB_NET_CDC_NCM=m
CONFIG_USB_NET_AX88179_178A=m

# Wireless for external adapters
CONFIG_CFG80211=m
CONFIG_MAC80211=m
CONFIG_MAC80211_MESH=y

# Basic filesystem & debug options
CONFIG_EXT4_FS=y
CONFIG_FUSE_FS=y
CONFIG_DEBUG_FS=y
CONFIG_PROC_FS=y
CONFIG_SYSFS=y
```
